## meta-samplebsp/conf/layer.conf
```bitbake
# We have a conf and classes directory, add to BBPATH
BBPATH .= ":${LAYERDIR}"

# We have recipes-* directories, add to BBFILES
BBFILES += "${LAYERDIR}/recipes-*/*/*.bb \
	${LAYERDIR}/recipes-*/*/*.bbappend"

BBFILE_COLLECTIONS += "samplebsp"
BBFILE_PATTERN_samplebsp = "^${LAYERDIR}/"
BBFILE_PRIORITY_samplebsp = "6"
```
